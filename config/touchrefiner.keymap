#include <behaviors.dtsi>
#include <dt-bindings/zmk/bt.h>
#include <dt-bindings/zmk/keys.h>

/ {
    keymap {
        compatible = "zmk,keymap";

        default_layer {
 
            bindings = <
&bt BT_CLR_ALL     &kp N2        &kp N4  &kp N6  &kp N8             &kp N0            &kp EQUAL          &kp INS    &kp N9
            >;
        };
    };
};
